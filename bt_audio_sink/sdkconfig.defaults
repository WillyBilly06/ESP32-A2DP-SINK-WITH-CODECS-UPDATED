## native_bt/esp32_probe/main/Kconfig.projbuild
```kconfig
menu "Native Bluetooth development output"
config NATIVE_AUDIO_BCLK
    int "I2S1 BCLK GPIO"
    range 0 33
    default 27
config NATIVE_AUDIO_LRCK
    int "I2S1 LRCK GPIO"
    range 0 33
    default 25
config NATIVE_AUDIO_DATA
    int "I2S1 data GPIO"
    range 0 33
    default 26
endmenu
```
