## bt_audio_sink/main/Kconfig.projbuild
```kconfig
menu "A2DP DSP BLE Configuration"

    menu "I2S Configuration"
        config I2S_BCK_PIN
            int "I2S BCK (Bit Clock) GPIO"
            default 27
            range 0 39
            help
                GPIO pin for I2S bit clock output.

        config I2S_LRCK_PIN
            int "I2S LRCK (Word Select) GPIO"
            default 25
            range 0 39
            help
                GPIO pin for I2S word select (left/right clock) output.

        config I2S_DATA_PIN
            int "I2S DATA GPIO"
            default 26
            range 0 39
            help
                GPIO pin for I2S data output.

        config I2S_DEFAULT_SAMPLE_RATE
            int "Default I2S sample rate"
            default 44100
            range 8000 192000
            help
                Default sample rate when no codec is configured.
    endmenu

    menu "GPIO Configuration"
        config BUTTON1_GPIO
            int "Button 1 GPIO (Bass Boost / Channel Flip)"
            default 18
            range 0 39
            help
                GPIO pin for button 1 (short press: bass boost, long press: channel flip).

        config BUTTON2_GPIO
            int "Button 2 GPIO (Bypass Toggle)"
            default 21
            range 0 39
            help
                GPIO pin for button 2 (bypass toggle).

        config BEAT_LED_GPIO
            int "Beat LED GPIO"
            default 5
            range 0 39
            help
                GPIO pin for beat detection LED.
    endmenu

    menu "DSP Configuration"
        config DSP_GOERTZEL_N
            int "Goertzel block size (samples)"
            default 512
            range 128 2048
            help
                Number of samples for Goertzel frequency analysis.
                Larger values give better frequency resolution but more latency.

        config DSP_CROSSOVER_LP_FREQ
            int "Crossover low-pass frequency (Hz)"
            default 90
            range 20 500
            help
                Low-pass cutoff frequency for split-ear mode subwoofer channel.

        config DSP_CROSSOVER_HP_FREQ
            int "Crossover high-pass frequency (Hz)"
            default 500
            range 100 2000
            help
                High-pass cutoff frequency for split-ear mode mid/high channel.

        config DSP_OUT_FRAMES
            int "DSP output buffer frames"
            default 1024
            range 256 8192
            help
                Maximum frames per DSP processing block.
                Larger values reduce overhead for high sample rate codecs like LDAC 96kHz.
    endmenu

    menu "Beat Detection"
        config BEAT_BASS_AVG_ALPHA
            int "Bass average alpha (x1000)"
            default 10
            range 1 100
            help
                Smoothing factor for bass average (divided by 1000).

        config BEAT_BASS_SMOOTH_ALPHA
            int "Bass smooth alpha (x1000)"
            default 350
            range 50 900
            help
                Smoothing factor for bass envelope (divided by 1000).

        config BEAT_BASS_MIN_LEVEL
            int "Minimum bass level (x10000)"
            default 120
            range 10 1000
            help
                Minimum bass level to trigger detection (divided by 10000).

        config BEAT_RATIO_THRESH
            int "Beat ratio threshold (x10)"
            default 16
            range 10 50
            help
                Ratio threshold for beat detection (divided by 10).

        config BEAT_MIN_INTERVAL_MS
            int "Minimum beat interval (ms)"
            default 90
            range 30 500
            help
                Minimum time between beats in milliseconds.

        config BEAT_FLASH_DURATION_MS
            int "Beat flash duration (ms)"
            default 60
            range 10 200
            help
                LED flash duration for beat detection.

        config LEVELS_UPDATE_MS
            int "Level meter update interval (ms)"
            default 50
            range 20 200
            help
                BLE level meter notification interval.
    endmenu

    menu "Device Settings"
        config DEFAULT_DEVICE_NAME
            string "Default Bluetooth device name"
            default "BDK SPEAKER"
            help
                Default name for Bluetooth advertising.

        config FIRMWARE_VERSION
            string "Firmware version"
            default "1.0.3"
            help
                Firmware version string reported via BLE.
    endmenu

    menu "Audio Buffer Configuration"
        config PSRAM_MODE
            bool "Use PSRAM for audio buffers"
            default y
            help
                Enable this if your ESP32 has PSRAM (WROVER modules).
                Disable for ESP32 without PSRAM (WROOM modules).
                When disabled, reduced buffer sizes are used to fit in internal RAM.

        config AUDIO_POOL_COUNT
            int "Audio buffer pool count"
            default 48 if PSRAM_MODE
            default 16 if !PSRAM_MODE
            range 8 128
            help
                Number of audio buffers in the pool.
                Reduced to 16 for non-PSRAM builds.

        config AUDIO_POOL_BUF_SIZE
            int "Audio buffer size (bytes)"
            default 8192 if PSRAM_MODE
            default 2048 if !PSRAM_MODE
            range 1024 32768
            help
                Size of each audio buffer in bytes.
                Reduced to 2048 for non-PSRAM builds.

        config OTA_BUFFER_SIZE
            int "OTA pre-buffer size (bytes)"
            default 16384 if PSRAM_MODE
            default 4096 if !PSRAM_MODE
            range 2048 65536
            help
                Size of OTA pre-begin buffer.
                Reduced for non-PSRAM builds.
    endmenu

    menu "LED Matrix Configuration"
        config LED_MATRIX_ENABLE
            bool "Enable WS2812B LED Matrix"
            default y
            help
                Enable the 16x16 WS2812B LED matrix with audio-reactive effects.

        config LED_MATRIX_GPIO
            int "LED Matrix Data GPIO"
            default 4
            range 0 39
            depends on LED_MATRIX_ENABLE
            help
                GPIO pin for WS2812B data line.

        config LED_BRIGHTNESS
            int "Default LED brightness (0-255)"
            default 64
            range 1 255
            depends on LED_MATRIX_ENABLE
            help
                Default brightness level for the LED matrix.
                Lower values reduce power consumption.

        config LED_FPS
            int "LED update rate (FPS)"
            default 30
            range 10 60
            depends on LED_MATRIX_ENABLE
            help
                Frame rate for LED effect updates.
                Higher values are smoother but use more CPU.

        config LED_DEMO_TIMEOUT
            int "Demo mode timeout (seconds)"
            default 5
            range 1 60
            depends on LED_MATRIX_ENABLE
            help
                Time without audio before switching to demo mode.

        config LED_EFFECT_BUTTON_GPIO
            int "Effect cycle button GPIO"
            default 19
            range 0 39
            depends on LED_MATRIX_ENABLE
            help
                GPIO pin for button to cycle through LED effects.
                Set to same as Button1 or Button2 to share a button.

        config LED_MATRIX_WIDTH
            int "Matrix width (pixels)"
            default 16
            range 1 32
            depends on LED_MATRIX_ENABLE
            help
                Width of the LED matrix.

        config LED_MATRIX_HEIGHT
            int "Matrix height (pixels)"
            default 16
            range 1 32
            depends on LED_MATRIX_ENABLE
            help
                Height of the LED matrix.
    endmenu

    menu "Rotary Encoder Configuration"
        config ENCODER_ENABLE
            bool "Enable Quad Rotary Encoder"
            default y
            help
                Enable Adafruit Quad Rotary Encoder Breakout (Product 5752)
                for hardware control of volume, EQ, and brightness.
                Single I2C device with 4 rotary encoders.

        config ENCODER_I2C_SDA_GPIO
            int "Encoder I2C SDA GPIO"
            default 23
            range 0 39
            depends on ENCODER_ENABLE
            help
                GPIO pin for encoder I2C data line (SDA).

        config ENCODER_I2C_SCL_GPIO
            int "Encoder I2C SCL GPIO"
            default 22
            range 0 39
            depends on ENCODER_ENABLE
            help
                GPIO pin for encoder I2C clock line (SCL).

        config ENCODER_ADDR_QUAD
            hex "Quad Encoder I2C address"
            default 0x07
            range 0x03 0x7F
            depends on ENCODER_ENABLE
            help
                I2C address for the Quad Rotary Encoder Breakout.
                Default 0x07 (user configured).
    endmenu

endmenu
```

## bt_audio_sink/recovery/sdkconfig.defaults
```kconfig
# Recovery partition SDK config - WiFi OTA
# Using WiFi for OTA updates with captive portal
# Bluetooth is completely disabled to save space
# OPTIMIZED FOR MINIMAL SIZE

# Disable Bluetooth entirely
CONFIG_BT_ENABLED=n

# Enable WiFi (minimal buffers)
CONFIG_ESP_WIFI_ENABLED=y
CONFIG_ESP32_WIFI_STATIC_RX_BUFFER_NUM=6
CONFIG_ESP32_WIFI_DYNAMIC_RX_BUFFER_NUM=16
CONFIG_ESP32_WIFI_DYNAMIC_TX_BUFFER_NUM=16
CONFIG_ESP_WIFI_SOFTAP_BEACON_MAX_LEN=752
CONFIG_ESP_WIFI_IRAM_OPT=n
CONFIG_ESP_WIFI_RX_IRAM_OPT=n
CONFIG_ESP_WIFI_ENABLE_WPA3_SAE=n
CONFIG_ESP_WIFI_11KV_SUPPORT=n
CONFIG_ESP_WIFI_MBO_SUPPORT=n
CONFIG_ESP_WIFI_DPP_SUPPORT=n

# Enable HTTP Server
CONFIG_HTTPD_MAX_REQ_HDR_LEN=1024
CONFIG_HTTPD_MAX_URI_LEN=512
CONFIG_HTTPD_WS_SUPPORT=n

# Enable HTTPS/TLS for secure OTA downloads (minimal mbedTLS)
CONFIG_ESP_TLS_USING_MBEDTLS=y
CONFIG_MBEDTLS_SSL_MAX_CONTENT_LEN=8192
CONFIG_MBEDTLS_CERTIFICATE_BUNDLE=y
CONFIG_MBEDTLS_CERTIFICATE_BUNDLE_DEFAULT_CMN=y

# Disable unused mbedTLS ciphers (keep only what's needed for HTTPS)
CONFIG_MBEDTLS_RC4_DISABLED=y
CONFIG_MBEDTLS_SSL_RENEGOTIATION=n
CONFIG_MBEDTLS_SSL_PROTO_TLS1=n
CONFIG_MBEDTLS_SSL_PROTO_TLS1_1=n
CONFIG_MBEDTLS_SSL_PROTO_DTLS=n
CONFIG_MBEDTLS_SSL_ALPN=y
CONFIG_MBEDTLS_CLIENT_SSL_SESSION_TICKETS=n
CONFIG_MBEDTLS_SERVER_SSL_SESSION_TICKETS=n
CONFIG_MBEDTLS_CAMELLIA_C=n
CONFIG_MBEDTLS_DES_C=n
CONFIG_MBEDTLS_BLOWFISH_C=n
CONFIG_MBEDTLS_XTEA_C=n
CONFIG_MBEDTLS_CCM_C=n
CONFIG_MBEDTLS_NIST_KW_C=n
CONFIG_MBEDTLS_RIPEMD160_C=n
CONFIG_MBEDTLS_PEM_WRITE_C=n
CONFIG_MBEDTLS_X509_CSR_PARSE_C=n
CONFIG_MBEDTLS_ECP_DP_SECP192R1_ENABLED=n
CONFIG_MBEDTLS_ECP_DP_SECP224R1_ENABLED=n
CONFIG_MBEDTLS_ECP_DP_SECP521R1_ENABLED=n
CONFIG_MBEDTLS_ECP_DP_SECP192K1_ENABLED=n
CONFIG_MBEDTLS_ECP_DP_SECP224K1_ENABLED=n
CONFIG_MBEDTLS_ECP_DP_SECP256K1_ENABLED=n
CONFIG_MBEDTLS_ECP_DP_BP256R1_ENABLED=n
CONFIG_MBEDTLS_ECP_DP_BP384R1_ENABLED=n
CONFIG_MBEDTLS_ECP_DP_BP512R1_ENABLED=n
CONFIG_MBEDTLS_ECP_DP_CURVE25519_ENABLED=n
CONFIG_MBEDTLS_ECP_DP_CURVE448_ENABLED=n

# HTTP Client settings
CONFIG_ESP_HTTP_CLIENT_ENABLE_HTTPS=y
CONFIG_ESP_HTTP_CLIENT_ENABLE_DIGEST_AUTH=n
CONFIG_ESP_HTTP_CLIENT_ENABLE_BASIC_AUTH=n

# Flash size
CONFIG_ESPTOOLPY_FLASHSIZE_8MB=y
CONFIG_PARTITION_TABLE_CUSTOM=y
CONFIG_PARTITION_TABLE_CUSTOM_FILENAME="../partitions.csv"

# Optimization for size
CONFIG_COMPILER_OPTIMIZATION_SIZE=y

# Use newlib nano for smaller size
CONFIG_NEWLIB_NANO_FORMAT=y

# Disable unused features
CONFIG_SPIRAM=n
CONFIG_ESP32_SPIRAM_SUPPORT=n

# Log level for debugging
CONFIG_LOG_DEFAULT_LEVEL_INFO=y
CONFIG_LOG_MAXIMUM_LEVEL_INFO=y

# LWIP settings (enough for httpd)
CONFIG_LWIP_DNS_MAX_SERVERS=2
CONFIG_LWIP_DHCP_RESTORE_LAST_IP=n
CONFIG_LWIP_IPV6=n
CONFIG_LWIP_NETIF_LOOPBACK=y
CONFIG_LWIP_LOOPBACK_MAX_PBUFS=8
CONFIG_LWIP_MAX_SOCKETS=16
CONFIG_LWIP_TCP_MAXRTX=6
CONFIG_LWIP_TCP_SYNMAXRTX=3
CONFIG_LWIP_STATS=n
CONFIG_LWIP_ETHARP_TRUST_IP_MAC=n
CONFIG_LWIP_DHCP_OPTIONS_LEN=68
CONFIG_LWIP_NUM_NETIF_CLIENT_DATA=0
CONFIG_LWIP_SNTP_MAX_SERVERS=1

# Disable unused ESP features
CONFIG_ESP_ERR_TO_NAME_LOOKUP=n
CONFIG_ESP_SYSTEM_EVENT_TASK_STACK_SIZE=2048

# Disable coredump
CONFIG_ESP_COREDUMP_ENABLE_TO_NONE=y

# Disable VFS features not needed
CONFIG_VFS_SUPPORT_TERMIOS=n

# Minimal FreeRTOS
CONFIG_FREERTOS_ENABLE_BACKWARD_COMPATIBILITY=n
```
